## main/Kconfig.projbuild
```kconfig
menu "Pin Configuration"

# LED Configuration
menu "LEDs"

config GPIO_LED_BUILTIN
    int "ESP builtin LED GPIO number"
    range 0 40
    default 15
    help
        Set the builtin LED GPIO number.

config GPIO_LED_BUILTIN_ACTIVE_STATE
    int "Builtin LED active state (0 for low, 1 for high)"
    range 0 1
    default 1
    help
        Set the active state for the builtin LED. Use 0 for active low, 1 for active high.

endmenu # End of LED Configuration


# Buttons Configuration
menu "Buttons"

config GPIO_BUTTON_BUILTIN
    int "ESP builtin button GPIO number"
    range 0 40
    default 0
    help
        Set the builtin button GPIO number.

config GPIO_BUTTON_BUILTIN_ACTIVE_STATE
    int "Builtin button active state (0 for low, 1 for high)"
    range 0 1
    default 0
    help
        Set the active state for the builtin button. Use 0 for active low, 1 for active high.
        This setting also enables internal pull-up or pull-down resistors accordingly.

endmenu # End of Buttons Configuration

# Config jumper Configuration
menu "Jumpers"

config GPIO_JUMPER_C1
    int "GPIO number for C1 jumper"
    range 0 40
    default 5
    help
        Specify the GPIO number assigned to the C1 jumper.

config GPIO_JUMPER_C1_ACTIVE_STATE
    int "Active state for C1 jumper (0 = low, 1 = high)"
    range 0 1
    default 0
    help
        Define the active state for the C1 jumper. Set 0 for active low or 1 for active high.
        This configuration also automatically enables the appropriate internal pull-up or pull-down resistors.

config GPIO_JUMPER_C2
    int "GPIO number for C2 jumper"
    range 0 40
    default 3
    help
        Specify the GPIO number assigned to the C2 jumper.

config GPIO_JUMPER_C2_ACTIVE_STATE
    int "Active state for C2 jumper (0 = low, 1 = high)"
    range 0 1
    default 0
    help
        Define the active state for the C2 jumper. Set 0 for active low or 1 for active high.
        This configuration also automatically enables the appropriate internal pull-up or pull-down resistors.

endmenu # End of Jumper Configuration

menu "LEDC Configuration"

    config LEDC_CH_0_GPIO
        int "LEDC Channel 0 GPIO"
        range 0 40
        default 39
        help
            GPIO pin number for LEDC Channel 0.

    config LEDC_CH_1_GPIO
        int "LEDC Channel 1 GPIO"
        range 0 40
        default 37
        help
            GPIO pin number for LEDC Channel 1.

    config LEDC_CH_2_GPIO
        int "LEDC Channel 2 GPIO"
        range 0 40
        default 35
        help
            GPIO pin number for LEDC Channel 2.

    config LEDC_CH_3_GPIO
        int "LEDC Channel 3 GPIO"
        range 0 40
        default 33
        help
            GPIO pin number for LEDC Channel 3.

    config LEDC_FREQ
        int "LEDC Frequency (Hz)"
        range 10 4000
        default 4000
        help
            Frequency for the LEDC timer in Hertz.
    
    config LEDC_FADE_TIME_MS
        int "LEDC Fade time in ms"
        range 1 4000
        default 500
        help
            Fade time for LEDC in milliseconds.

endmenu

menu "Encoder Configuration"

    config ENCODER_GPIO_A
        int "Encoder A GPIO number"
        range 0 40
        default 9
        help
            GPIO pin number for encoder A pin.

    config ENCODER_GPIO_B
        int "Encoder B GPIO number"
        range 0 40
        default 12
        help
            GPIO pin number for encoder B pin.

    config ENCODER_BUTTON_GPIO
        int "Encoder button GPIO number"
        range 0 40
        default 11
        help
            GPIO pin number for encoder button.

    config ENCODER_BUTTON_GPIO_ACTIVE_LEVEL
        int "Builtin button active level (0 for low, 1 for high)"
        range 0 1
        default 0
        help
            Set the active level for the builtin button. Use 0 for active low, 1 for active high.
            This setting also enables internal pull-up or pull-down resistors accordingly.

    config ENCODER_PULSES_PER_STEP
        int "Encoder pulses per step"
        range 0 8
        default 4
        help
            Specifies the number of pulses generated by the encoder for each step.

    config ENCODER_GLITCH_FILTER_TIME_NS
        int "Encoder glitch filter time in ns"
        range 0 10000
        default 1000
        help
            Pulse width smaller than this threshold will be treated as glitch and ignored.


endmenu

endmenu # End of Pin Configuration
```

## sdkconfig.defaults
```kconfig
CONFIG_ESPTOOLPY_FLASHSIZE_4MB=y
CONFIG_ESP_SYSTEM_PANIC_REBOOT_DELAY_SECONDS=3
CONFIG_LINK_CONFIG_SIZE=3
CONFIG_LINK_STATUS_FMT_SIZE=256
CONFIG_LINK_DATA_FMT_SIZE=3
```
